#include "U8glib.h"

U8GLIB_SSD1306_128X32 u8g(U8G_I2C_OPT_DEV_0 | U8G_I2C_OPT_NO_ACK | U8G_I2C_OPT_FAST); // Fast I2C / TWI

// 'oled_tutorial', 128x32px
const unsigned char epd_bitmap_oled_tutorial [] PROGMEM = {
	0x3f, 0xff, 0xff, 0xff, 0xff, 0xff, 0xff, 0xff, 0xff, 0xff, 0xff, 0xff, 0xff, 0xff, 0xff, 0x80, 
	0x40, 0x00, 0x00, 0x00, 0x00, 0x00, 0x00, 0x00, 0x00, 0x00, 0x00, 0x00, 0x00, 0x00, 0x00, 0x42, 
	0x44, 0x20, 0x00, 0x00, 0x00, 0x00, 0x00, 0x00, 0x00, 0x00, 0x00, 0x00, 0x00, 0x00, 0x00, 0x40, 
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	0x00, 0x00, 0x00, 0x00, 0x00, 0x00, 0x00, 0x00, 0x00, 0x00, 0x00, 0x00, 0x00, 0x00, 0x00, 0x00
};

// ' icon_barrage', 16x16px
const unsigned char epd_bitmap__icon_barrage [] PROGMEM = {
	0x00, 0x00, 0x00, 0x00, 0x00, 0x00, 0x0d, 0xb0, 0x0d, 0xb0, 0x0d, 0xb0, 0x05, 0xa0, 0x00, 0x00, 
	0x07, 0xe0, 0x0b, 0xd0, 0x10, 0x08, 0x1b, 0xd8, 0x1b, 0xd8, 0x00, 0x00, 0x00, 0x00, 0x00, 0x00
};
// ' icon_bomb', 16x16px
const unsigned char epd_bitmap__icon_bomb [] PROGMEM = {
	0x00, 0x00, 0x00, 0x00, 0x04, 0x20, 0x06, 0x60, 0x03, 0xc0, 0x07, 0xe0, 0x07, 0xe0, 0x07, 0xe0, 
	0x07, 0xe0, 0x07, 0xe0, 0x03, 0xc0, 0x01, 0x80, 0x00, 0x00, 0x00, 0x00, 0x00, 0x00, 0x00, 0x00
};

// Array of all bitmaps for convenience. (Total bytes used to store images in PROGMEM = 96)
const unsigned char* bitmap_icons[2] = {
	epd_bitmap__icon_bomb,
  epd_bitmap__icon_barrage
};

// ' item_sel_background', 128x15px
const unsigned char epd_bitmap__item_sel_background [] PROGMEM = {
	0x3f, 0xff, 0xff, 0xff, 0xff, 0xff, 0xff, 0xff, 0xff, 0xff, 0xff, 0xff, 0xff, 0xff, 0xff, 0x80, 
	0x40, 0x00, 0x00, 0x00, 0x00, 0x00, 0x00, 0x00, 0x00, 0x00, 0x00, 0x00, 0x00, 0x00, 0x00, 0x40, 
	0x40, 0x00, 0x00, 0x00, 0x00, 0x00, 0x00, 0x00, 0x00, 0x00, 0x00, 0x00, 0x00, 0x00, 0x00, 0x40, 
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	0x1f, 0xff, 0xff, 0xff, 0xff, 0xff, 0xff, 0xff, 0xff, 0xff, 0xff, 0xff, 0xff, 0xff, 0xff, 0x00
};
// ' scrollbar_background', 8x32px
const unsigned char epd_bitmap__scrollbar_background [] PROGMEM = {
	0x00, 0x02, 0x00, 0x02, 0x00, 0x02, 0x00, 0x02, 0x00, 0x02, 0x00, 0x02, 0x00, 0x02, 0x00, 0x02, 
	0x00, 0x02, 0x00, 0x02, 0x00, 0x02, 0x00, 0x02, 0x00, 0x02, 0x00, 0x02, 0x00, 0x02, 0x00, 0x00
};

#define BUTTON_UP_PIN 4
#define BUTTON_DOWN_PIN 8

int button_up_clicked = 0;
int button_down_clicked = 0;

const int NUM_ITEMS = 2;

char menu_item[NUM_ITEMS][20] = {
  {"500kg Bomb"},
	{"120mm Barrage"}
};

int item_selected = 0;

int item_sel_previous;
int item_sel_next;

void setup() {
  pinMode(BUTTON_UP_PIN, INPUT_PULLUP);
  pinMode(BUTTON_DOWN_PIN, INPUT_PULLUP);

  u8g.setFont(u8g_font_tpssb);
  u8g.setColorIndex(1);
}

void loop() {
  if ((digitalRead(BUTTON_UP_PIN) == LOW) && (button_up_clicked == 0)) {
    item_selected = item_selected - 1;
    button_up_clicked = 1;
    if (item_selected < 0) {
    item_selected = NUM_ITEMS-1;
    }
  }

  if ((digitalRead(BUTTON_DOWN_PIN) == LOW) && (button_down_clicked == 0)) {
    item_selected = item_selected + 1;
    button_down_clicked = 1;
    if (item_selected >= NUM_ITEMS) {
    item_selected = 0;
    }
  }

  if ((digitalRead(BUTTON_UP_PIN) == HIGH) && (button_up_clicked == 1)) {
    button_up_clicked = 0;
  }

  if ((digitalRead(BUTTON_DOWN_PIN) == HIGH) && (button_down_clicked == 1)) {
    button_down_clicked = 0;
  }

  item_sel_previous = item_selected - 1;
  if (item_sel_previous < 0) {
  item_sel_previous = NUM_ITEMS-1;
  }

  item_sel_next = item_selected + 1;
  if (item_sel_next >= NUM_ITEMS) {
  item_sel_next = 0;
  }

  u8g.firstPage();
  do {
    u8g.setFont(u8g_font_7x14);
    u8g.drawStr(16, 12, menu_item[item_sel_previous]);
    u8g.drawBitmapP(0, 0, 16/8, 16, bitmap_icons[item_sel_previous]);

    u8g.setFont(u8g_font_7x14);
    u8g.drawStr(16, 29, menu_item[item_selected]);
    u8g.drawBitmapP(0, 16, 16/8, 16, bitmap_icons[item_selected]);

    u8g.drawBitmapP(0, 17, 128/8, 15, epd_bitmap__item_sel_background);
    u8g.drawBitmapP(120, 0, 8/8, 32, epd_bitmap__scrollbar_background);
  } while (u8g.nextPage());
}